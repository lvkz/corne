## config/west.yml
```yaml
manifest:
  defaults:
    revision: v0.3
  remotes:
    - name: zmkfirmware
      url-base: https://github.com/zmkfirmware
    - name: lvkz
      url-base: https://github.com/lvkz
  projects:
    - name: zmk
      remote: zmkfirmware
      import: app/west.yml
    - name: bs-corne_zmk_config
      remote: lvkz
      revision: master
  self:
    path: config
```
